## drivers/video/bridge/Kconfig
```kconfig
config VIDEO_BRIDGE
	bool "Support video bridges"
	depends on DM
	help
	  Some platforms use video bridges to convert from one output to
	  another. For example, where the SoC only supports eDP and the LCD
	  requires LVDS, an eDP->LVDS bridge chip can be used to provide the
	  necessary conversion. This option enables support for these devices.

config SPL_VIDEO_BRIDGE
	bool "Support video bridges in SPL"
	depends on SPL_DM
	help
	  Enable video bridge support in SPL. This is needed when a video
	  bridge (e.g. DSI-to-DPI) is required during SPL, such as for
	  displaying a splash screen before the main U-Boot is loaded.

config VIDEO_BRIDGE_PARADE_DP501
	bool "Support Parade DP501 DP & DVI/HDMI dual mode transmitter"
	depends on VIDEO_BRIDGE && PANEL && DM_GPIO
	select DM_I2C
	help
	  The Parade DP501 is a DP & DVI/HDMI dual-mode transmitter. It
	  enables an RGB/Parallel SOC output to be converted, packed and
	  serialized into either DP or TMDS output device. Only DisplayPort
	  functionality of this transmitter has been implemented and tested.

config VIDEO_BRIDGE_PARADE_PS862X
	bool "Support Parade PS862X DP->LVDS bridge"
	depends on VIDEO_BRIDGE
	help
	  The Parade PS8622 and PS8625 are DisplayPort-to-LVDS (Low voltage
	  differential signalling) converters. They enable an LVDS LCD panel
	  to be connected to an eDP output device such as an SoC that lacks
	  LVDS capability, or where LVDS requires too many signals to route
	  on the PCB. Setup parameters are provided in the device tree.

config VIDEO_BRIDGE_NXP_PTN3460
	bool "Support NXP PTN3460 DP->LVDS bridge"
	depends on VIDEO_BRIDGE
	help
	  The NXP PTN3460 is a DisplayPort-to-LVDS (Low voltage differential
	  signalling) converter. It enables an LVDS LCD panel to be connected
	  to an eDP output device such as an SoC that lacks LVDS capability,
	  or where LVDS requires too many signals to route on the PCB.

config VIDEO_BRIDGE_ANALOGIX_ANX6345
	bool "Support Analogix ANX6345 RGB->DP bridge"
	depends on VIDEO_BRIDGE
	select DM_I2C
	help
	 The Analogix ANX6345 is RGB-to-DP converter. It enables an eDP LCD
	 panel to be connected to an parallel LCD interface.

config VIDEO_BRIDGE_SOLOMON_SSD2825
	bool "Solomon SSD2825 bridge driver"
	depends on VIDEO_BRIDGE && PANEL && DM_GPIO
	select VIDEO_MIPI_DSI
	help
	  Solomon SSD2824 SPI RGB-DSI bridge driver.

config VIDEO_BRIDGE_TOSHIBA_TC358762
	bool "Support Toshiba TC358762 DSI/DPI bridge"
	depends on VIDEO_BRIDGE && PANEL && DM_GPIO
	select VIDEO_MIPI_DSI
	help
	  Toshiba TC358762 DSI-to-DPI bridge chip driver.
	  Receives MIPI DSI input and outputs DPI to a downstream panel.
	  Found on the Raspberry Pi 7-inch touchscreen display.

config SPL_VIDEO_BRIDGE_TOSHIBA_TC358762
	bool "Support Toshiba TC358762 DSI/DPI bridge in SPL"
	depends on SPL_VIDEO_BRIDGE
	select SPL_VIDEO_MIPI_DSI
	help
	  Enable the Toshiba TC358762 DSI-to-DPI bridge driver in SPL.
	  Required for DSI splash screen display before main U-Boot.

config VIDEO_BRIDGE_TOSHIBA_TC358768
	bool "Support Toshiba TC358768 MIPI DSI bridge"
	depends on VIDEO_BRIDGE && PANEL && DM_GPIO
	select VIDEO_MIPI_DSI
	select DM_I2C
	help
	  Toshiba TC358768AXBG/TC358778XBG DSI bridge chip driver.
	  Found in Asus Transformer Infinity TF700T.

config VIDEO_BRIDGE_LVDS_CODEC
	bool "Transparent LVDS encoders and decoders support"
	depends on VIDEO_BRIDGE && PANEL && DM_GPIO
	help
	  Support for transparent LVDS encoders and decoders that don't
	  require any configuration.

config VIDEO_BRIDGE_SAMSUNG_CMC623
	bool "Samsung CMC623 Image Converter driver"
	depends on VIDEO_BRIDGE && DM_GPIO
	select DM_I2C
	help
	  Samsung CMC623 image converter chip driver.
	  Found in several Samsung devices such as N1

config VIDEO_BRIDGE_DP_CONNECTOR
	bool "Support DisplayPort connector stub"
	depends on VIDEO_BRIDGE
	help
	  Enable the dp-connector stub driver. Required when the eDP bridge
	  driver needs to walk the OF graph to detect the connector type
	  (DisplayPort vs eDP).

config SPL_VIDEO_BRIDGE_DP_CONNECTOR
        bool "Support DisplayPort connector stub in SPL"
        depends on SPL_VIDEO_BRIDGE
        help
          Enable the dp-connector stub driver in SPL. Required when the
          eDP bridge driver needs to walk the OF graph during SPL to
          detect the connector type (DisplayPort vs eDP).

config VIDEO_BRIDGE_SII902X
	bool "Support Silicon Image SII902x HDMI bridge in SPL"
	depends on SPL_VIDEO_BRIDGE
	select SPL_DM_I2C
	help
	  The Silicon Image SII902x is a DPI-to-HDMI bridge. It enables
	  an HDMI display and supports reading the EDID block.

config SPL_VIDEO_BRIDGE_SII902X
	bool "Support Silicon Image SII902x HDMI bridge"
	depends on SPL_VIDEO_BRIDGE
	select DM_I2C
	help
	  Enable SII902x bridge driver in SPL.
	  Required for HDMI splash screen display before U-Boot proper.

config VIDEO_BRIDGE_TI_SN65DSI86
	bool "Support TI SN65DSI86 DSI-to-eDP bridge"
	depends on VIDEO_BRIDGE && DM_GPIO
	select DM_I2C
	select VIDEO_MIPI_DSI
	help
	  TI SN65DSI86 DSI-to-eDP/DP bridge driver for J722S EVM.
	  Reads EDID via AUX channel, performs link training, and
	  streams video over eDP/DisplayPort. Enables the bridge so
	  a splash screen can be shown on eDP panels during U-Boot.

config SPL_VIDEO_BRIDGE_TI_SN65DSI86
	bool "Support TI SN65DSI86 DSI-to-eDP bridge in SPL"
	depends on SPL_VIDEO_BRIDGE
	select SPL_DM_I2C
	select SPL_VIDEO_MIPI_DSI
	help
	  TI SN65DSI86 DSI-to-eDP/DP bridge driver for SPL. Reads EDID via
	  AUX channel, performs link training, and streams video over
	  eDP/DisplayPort. Required for eDP splash screen display before
	  main U-Boot. Enables the bridge at SPL stage so a splash screen
	  can be shown on eDP panels early in the boot process.
```
